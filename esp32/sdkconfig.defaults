## esp32/sdkconfig.defaults
```kconfig
# WiFi (required for ESP-NOW)
CONFIG_ESP_WIFI_SOFTAP_SUPPORT=y
CONFIG_ESP_WIFI_STA_RX_BUFFER_NUM=30
CONFIG_ESP_WIFI_SOFTAP_RX_BUFFER_NUM=30
CONFIG_ESP_WIFI_RX_BA_WIN=15

# UART0 for KISS communication with host
CONFIG_ESP_CONSOLE_UART_DEFAULT=y
CONFIG_ESP_CONSOLE_UART_BAUDRATE=115200
CONFIG_UART_ISR_IN_IRAM=y

# CPU frequency — 240 MHz
CONFIG_ESP_DEFAULT_CPU_FREQ_MHZ_240=y

# Flash size (4MB)
CONFIG_ESPTOOLPY_FLASHSIZE_4MB=y

# Flash chip support
CONFIG_SPI_FLASH_SUPPORT_BOYA_CHIP=y

# FreeRTOS
CONFIG_FREERTOS_HZ=1000
```

## esp8266/sdkconfig.defaults
```kconfig
# UART0 for KISS — no console on this port
CONFIG_ESP_CONSOLE_UART_NONE=y

# WiFi buffers
CONFIG_ESP8266_WIFI_RX_BUFFER_NUM=30

# FreeRTOS tick rate
CONFIG_FREERTOS_HZ=1000

# Flash size (4MB)
CONFIG_ESPTOOLPY_FLASHSIZE_4MB=y

# Partition table
CONFIG_PARTITION_TABLE_SINGLE_APP=y
```
